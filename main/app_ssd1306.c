/**
 * @file    app_ssd1306.c
 * @brief   SSD1306 128x64 OLED I²C 驱动 (S5)
 *
 * I²C 通信: 控制字节 0x00=命令, 0x40=数据
 * 帧缓冲: 1024 字节 (128×64 / 8), 页寻址模式
 * 字体:   5×7 等宽, 95 字符 (ASCII 32-126), 移植自 STM32 原项目
 */

#include "app_ssd1306.h"

#include "esp_log.h"
#include "freertos/FreeRTOS.h"
#include "freertos/task.h"
#include <string.h>

static const char *TAG = "ssd1306";

/* ---- I²C 设备句柄 ---- */
static i2c_master_dev_handle_t dev_handle = NULL;

/* ---- 128×64 帧缓冲 (1 bit/pixel, 页寻址) ---- */
static uint8_t framebuf[SSD1306_WIDTH * SSD1306_HEIGHT / 8];

/* ================================================================
 * 5×7 等宽字体: ASCII 32 (空格) ~ 126 (~), 共 95 字符
 * 每字符 5 字节, 每字节代表一列 8 像素 (bit0=顶)
 * ================================================================ */
static const uint8_t font5x7[95][5] = {
    {0x00,0x00,0x00,0x00,0x00}, /*  32 SP */
    {0x00,0x00,0x5F,0x00,0x00}, /*  33 !  */
    {0x00,0x07,0x00,0x07,0x00}, /*  34 "  */
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    {0x08,0x08,0x2A,0x1C,0x08}, /* 126 ~  */
};

/* ================================================================
 * I²C 底层: 写命令 (控制字节 0x00 + 命令字节)
 * ================================================================ */
static esp_err_t ssd1306_write_cmd(uint8_t cmd)
{
    if (dev_handle == NULL) return ESP_ERR_INVALID_STATE;
    uint8_t buf[2] = { 0x00, cmd };
    return i2c_master_transmit(dev_handle, buf, 2, 100);
}

/* ================================================================
 * I²C 底层: 写数据 (控制字节 0x40 + payload)
 * ================================================================ */
static esp_err_t ssd1306_write_data(const uint8_t *data, size_t len)
{
    if (dev_handle == NULL) return ESP_ERR_INVALID_STATE;
    if (len > 128) return ESP_ERR_INVALID_ARG;

    uint8_t buf[129];       /* 1 控制字节 + 最多 128 数据 */
    buf[0] = 0x40;
    memcpy(&buf[1], data, len);
    return i2c_master_transmit(dev_handle, buf, len + 1, 200);
}

/* ================================================================
 * SSD1306 初始化序列 (I²C 模式, 页寻址)
 * ================================================================ */
void SSD1306_Init(i2c_master_bus_handle_t bus)
{
    /* ---- 注册 OLED 设备到 I²C 总线 ---- */
    i2c_device_config_t dev_cfg = {
        .dev_addr_length = I2C_ADDR_BIT_LEN_7,
        .device_address  = SSD1306_ADDR,
        .scl_speed_hz    = 100000,
    };
    esp_err_t ret = i2c_master_bus_add_device(bus, &dev_cfg, &dev_handle);
    if (ret != ESP_OK) {
        ESP_LOGE(TAG, "SSD1306 bus_add_device failed: %s", esp_err_to_name(ret));
        return;
    }

    vTaskDelay(pdMS_TO_TICKS(100));     /* 等待 OLED 上电稳定 */

    /* ---- 初始化命令序列 ---- */
    ssd1306_write_cmd(0xAE);   /* display off */
    ssd1306_write_cmd(0xD5); ssd1306_write_cmd(0x80);   /* clock div */
    ssd1306_write_cmd(0xA8); ssd1306_write_cmd(0x3F);   /* mux ratio = 64 */
    ssd1306_write_cmd(0xD3); ssd1306_write_cmd(0x00);   /* display offset */
    ssd1306_write_cmd(0x40);                             /* start line */
    ssd1306_write_cmd(0x8D); ssd1306_write_cmd(0x14);   /* charge pump */
    ssd1306_write_cmd(0x20); ssd1306_write_cmd(0x00);   /* horizontal addr mode */
    ssd1306_write_cmd(0xA1);                             /* segment remap (左右翻转) */
    ssd1306_write_cmd(0xC8);                             /* COM scan direction (上下翻转) */
    ssd1306_write_cmd(0xDA); ssd1306_write_cmd(0x12);   /* COM pins */
    ssd1306_write_cmd(0x81); ssd1306_write_cmd(0xCF);   /* contrast */
    ssd1306_write_cmd(0xD9); ssd1306_write_cmd(0xF1);   /* pre-charge */
    ssd1306_write_cmd(0xDB); ssd1306_write_cmd(0x40);   /* VCOMH */
    ssd1306_write_cmd(0xA4);                             /* resume to RAM content */
    ssd1306_write_cmd(0xA6);                             /* normal (非反色) */
    ssd1306_write_cmd(0xAF);                             /* display ON */

    ESP_LOGI(TAG, "SSD1306 initialized (addr 0x%02X, %dx%d)", SSD1306_ADDR,
             SSD1306_WIDTH, SSD1306_HEIGHT);

    SSD1306_Clear();
    SSD1306_Update();
}

/* ================================================================
 * 清空帧缓冲
 * ================================================================ */
void SSD1306_Clear(void)
{
    memset(framebuf, 0, sizeof(framebuf));
}

/* ================================================================
 * 在 (col, page) 位置写 ASCII 字符串
 * 每字符占 6×8 像素, 128×64 = 21 字符 × 8 行
 * ================================================================ */
void SSD1306_WriteString(uint8_t col, uint8_t page,
                         const char *str, uint8_t invert)
{
    while (*str) {
        char c = *str++;
        if (c < 32 || c > 126) c = '?';

        uint16_t px = (uint16_t)col * 6;
        if (px > SSD1306_WIDTH - 6) break;      /* 超出屏幕宽度 */

        for (uint8_t i = 0; i < 5; i++) {
            uint8_t g = font5x7[(uint8_t)(c - 32)][i];
            if (invert) g = ~g;
            framebuf[(uint16_t)page * SSD1306_WIDTH + px + i] = g;
        }
        framebuf[(uint16_t)page * SSD1306_WIDTH + px + 5] = 0;   /* 列间距 */
        col++;
    }
}

/* ================================================================
 * 将帧缓冲刷新到 OLED (按页逐行 I²C 写入)
 * ================================================================ */
void SSD1306_Update(void)
{
    if (dev_handle == NULL) return;

    for (uint8_t page = 0; page < SSD1306_PAGES; page++) {
        ssd1306_write_cmd(0xB0 + page);         /* 设置页地址 */
        ssd1306_write_cmd(0x00);                 /* 列低地址 */
        ssd1306_write_cmd(0x10);                 /* 列高地址 */
        ssd1306_write_data(&framebuf[page * SSD1306_WIDTH],
                           SSD1306_WIDTH);
    }
}
